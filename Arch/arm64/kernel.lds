ENTRY(_start)

SECTIONS {
	
	__text_start = .;
	.text :
	{
		KEEP(*(.text.boot))
		/* FIXME: below can generated by macro */
		__initcall_init_start = .;
        __initcall_init_lv0_start = .;
        *(.initcall_lv0.init)
        __initcall_init_lv0_end = .;
        __initcall_init_lv1_start = .;
        KEEP(*(.initcall_lv1.init))
        __initcall_init_lv1_end = .;
        __initcall_init_lv2_start = .;
        KEEP(*(.initcall_lv2.init))
        __initcall_init_lv2_end = .;
        __initcall_init_lv3_start = .;
        KEEP(*(.initcall_lv3.init))
        __initcall_init_lv3_end = .;
        __initcall_init_lv4_start = .;
        KEEP(*(.initcall_lv4.init))
        __initcall_init_lv4_end = .;
        __initcall_init_lv5_start = .;
        KEEP(*(.initcall_lv5.init))
        __initcall_init_lv5_end = .;
        __initcall_init_end  = .;
		*(.text)
	}
	. = ALIGN(4096);
	__test_end = .;

	__rodata_start = .;
	.rodata :
	{
		*(.rodata)
	}
	. = ALIGN(4096);
	__rodata_end = .;

	__data_start = .;
	.data :
	{
		*(.data)
	}
	. = ALIGN(4096);
	__data_end = .;

	__bss_start = .;
	.bss :
	{
		*(.bss)
	}
	. = ALIGN(4096);
	__bss_end = .;

	. = 0x8000 + __bss_end;
    __stack_base = .;
}